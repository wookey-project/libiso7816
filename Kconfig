## Kconfig
```kconfig
config USR_LIB_ISO7816
  bool  "iso7816-3 protocol stack (without platform dependencies)"
  default y
  select USR_DRV_ISO7816
  ---help---
  Support for the iso7816-3 standard, excluding the platform
  specific interface, hosted in the dedicated iso7816 driver.
  For the iso7816 standard T=0 & T=1 are supported.
config USR_LIB_ISO7816_CFLAGS
  string
  default " -I../../libs/iso7816/api " if USR_LIB_ISO7816
```
